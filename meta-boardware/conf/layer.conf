## meta-boardware/conf/layer.conf
```bitbake
# We have a conf and classes directory, add to BBPATH
BBPATH := "${BBPATH}:${LAYERDIR}"

# We have an images and various recipe-* directories, add to BBFILES
BBFILES := "${BBFILES} ${LAYERDIR}/images/*.bb ${LAYERDIR}/recipes-*/*/*.bb"
	
BBFILE_COLLECTIONS += "boardware"
BBFILE_PATTERN_boardware := "^${LAYERDIR}/"
BBFILE_PRIORITY_boardware = "6"
```

## meta-boardware/conf/machine/bw-b100.conf
```bitbake
#@TYPE: Machine
#@Name: Samsung MINI2440 Dev Board
#@DESCRIPTION: Machine configuration for MINI2440 Dev Board


TARGET_ARCH = "arm"
#PACKAGE_EXTRA_ARCHS = "armv4t"
PREFERRED_PROVIDER_virtual/xserver = "xserver-kdrive"

#Ship all kernel modules till the board support has matured enough
MACHINE_EXTRA_RRECOMMENDS += "kernel-modules"
#IMAGE_INSTALL += "kernel-modules"
MACHINE_ESSENTIAL_EXTRA_RRECOMMENDS += "kernel-modules"

#PREFERRED_VERSION_u-boot = "git"
UBOOT_ENTRYPOINT = "0x30008000"
#UBOOT_LOADADDRESS = "0x30008000"
#PREFERRED_PROVIDER_virtual/kernel = "linux-mini2440-fa"
PREFERRED_PROVIDER_virtual/kernel = "linux-bw-b100"
#GCCVERSION = "4.5.1.linaro"

# used by sysvinit_2
SERIAL_CONSOLE = "115200 ttySAC0"

IMAGE_DEVICE_TABLES = "files/device_table-minimal.txt \
                       files/device_table_add-s3c_serial.txt"

IMAGE_FSTYPES = "jffs2 tar.gz"

MACHINE_FEATURES = "kernel26 uboot touchscreen screen lcd rgb16"
MACHINE_FEATURES += "usbhost usbgadget"
MACHINE_FEATURES += "i2c spi"
MACHINE_FEATURES += "mmc mmcroot vfat"
MACHINE_FEATURES += "ethernet"
MACHINE_FEATURES += "sound alsa "
KERNEL_IMAGETYPE = "uImage"

require conf/machine/include/tune-arm920t.inc

#MACHINE_EXTRA_RDEPENDS = "rt73-firmware"
#EXTRA_IMAGEDEPENDS += "u-boot"
EXTRA_IMAGECMD_jffs2 = "--pad --little-endian --squash -s 0x200 -n -e 16KiB"
GUI_MACHINE_CLASS = "smallscreen"
```
